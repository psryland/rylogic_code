//*******************************************************************************************
// LineDrawer
//	(c)opyright 2002 Rylogic Limited
//*******************************************************************************************
#ifndef LDR_OBJECT
#define LDR_OBJECT(identifier, hash)
#endif//LDR_OBJECT
#ifndef LDR_KEYWORD
#define LDR_KEYWORD(identifier, hash)
#endif//LDR_KEYWORD

LDR_KEYWORD(Position, 0)
LDR_KEYWORD(Transform, 1)
LDR_KEYWORD(Transpose, 2)
LDR_KEYWORD(Inverse, 3)
LDR_KEYWORD(Orthonormalise, 4)
LDR_KEYWORD(Up, 5)
LDR_KEYWORD(LookAt, 6)
LDR_KEYWORD(PositionX, 7)
LDR_KEYWORD(PositionY, 8)
LDR_KEYWORD(PositionZ, 9)
LDR_KEYWORD(FOV, 10)
LDR_KEYWORD(Aspect, 11)
LDR_KEYWORD(Far, 12)
LDR_KEYWORD(AlignX, 13)
LDR_KEYWORD(AlignY, 14)
LDR_KEYWORD(AlignZ, 15)
LDR_KEYWORD(TransX, 16)
LDR_KEYWORD(TransY, 17)
LDR_KEYWORD(TransZ, 18)
LDR_KEYWORD(RotX, 19)
LDR_KEYWORD(RotY, 20)
LDR_KEYWORD(RotZ, 21)
LDR_KEYWORD(Zoom, 22)
LDR_KEYWORD(CameraRelative, 23)
LDR_KEYWORD(Normalise, 24)
LDR_KEYWORD(Parametric, 25)
LDR_KEYWORD(Divisions, 26)
LDR_KEYWORD(VertexColours, 27)
LDR_KEYWORD(Camera, 28)
LDR_KEYWORD(Lock, 29)
LDR_KEYWORD(Delimiters, 30)
LDR_KEYWORD(GlobalWireframe, 31)

LDR_OBJECT(Points, 100)
LDR_OBJECT(Lines, 101)
LDR_OBJECT(Group, 102)
LDR_OBJECT(Point, 103)
LDR_OBJECT(Line, 104)
LDR_OBJECT(LineD, 105)
LDR_OBJECT(LineNL, 106)
LDR_OBJECT(LineList, 107)
LDR_OBJECT(Rectangle, 108)
LDR_OBJECT(RectangleLU, 109)
LDR_OBJECT(RectangleWHZ, 110)
LDR_OBJECT(CircleR, 111)
LDR_OBJECT(CircleRxRyZ, 112)
LDR_OBJECT(Matrix3x3, 113)
LDR_OBJECT(Matrix4x4, 114)
LDR_OBJECT(GridWH, 115)
LDR_OBJECT(Triangle, 116)
LDR_OBJECT(Quad, 117)
LDR_OBJECT(QuadLU, 118)
LDR_OBJECT(QuadWHZ, 119)
LDR_OBJECT(BoxWHD, 120)
LDR_OBJECT(BoxLU, 121)
LDR_OBJECT(BoxList, 122)
LDR_OBJECT(FrustumWHNF, 123)
LDR_OBJECT(FrustumATNF, 124)
LDR_OBJECT(CylinderHR, 125)
LDR_OBJECT(CylinderHRxRz, 126)
LDR_OBJECT(SphereR, 127)
LDR_OBJECT(SphereRxRyRz, 128)
LDR_OBJECT(Mesh, 129)
LDR_OBJECT(Polytope, 130)
LDR_OBJECT(SurfaceWHD, 131)
LDR_OBJECT(File, 132)

#undef LDR_OBJECT
#undef LDR_KEYWORD